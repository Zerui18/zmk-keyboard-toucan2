## Kconfig
```kconfig
config TOUCAN_SOFT_POWER
    bool "Toucan per-half soft power chord"
    default y if SHIELD_TOUCAN_LEFT || SHIELD_TOUCAN_RIGHT
    depends on SOC_NRF52840
    select ZMK_PM_SOFT_OFF
    help
      Recognize a deliberate layer-thumb tap-release-hold followed by a
      four-key chord, and put only that half into nRF System OFF. A retained
      marker and matrix-key wake source require the five physical keys to wake.

if TOUCAN_SOFT_POWER

config TOUCAN_SOFT_POWER_ARM_TAP_MAX_MS
    int "Maximum duration of the arming tap"
    range 50 500
    default 200
    help
      The layer thumb's first press must be released within this interval. The
      tap is observed without delaying its normal momentary-layer behavior.

config TOUCAN_SOFT_POWER_ARM_WINDOW_MS
    int "Maximum delay before the arming hold"
    range 50 1000
    default 300
    help
      After the isolated tap, the same layer thumb must be pressed again within
      this interval and remain held while entering the shutdown chord.

config TOUCAN_SOFT_POWER_CAPTURE_TIMEOUT_MS
    int "Shutdown chord capture interval"
    range 250 5000
    default 1500
    help
      Time after the second layer-thumb press during which the four shutdown
      keys may be entered. After this expires, all keys behave normally again.

config TOUCAN_SOFT_POWER_CHORD_TIMEOUT_MS
    int "Maximum interval for the power-off chord"
    range 50 500
    default 120
    help
      Once capture is armed, all four character keys must be pressed within
      this interval. Any other key invalidates the attempt.

config TOUCAN_SOFT_POWER_WAKE_VALIDATION_MS
    int "Wake chord validation interval"
    range 50 3000
    default 1000
    help
      Maximum time during early boot to wait for the complete wake chord. Only
      the GPIO matrix is active during this interval; Bluetooth and the normal
      ZMK application have not started yet.

config TOUCAN_SOFT_POWER_WAKE_STABLE_MS
    int "Required stable wake chord time"
    range 5 100
    default 20
    help
      Time for which the exact wake chord must scan continuously, allowing
      switch bounce to settle before the firmware accepts the wake.

config TOUCAN_SOFT_POWER_OFF_DELAY_MS
    int "Released-key settling time before soft off"
    range 0 100
    default 25
    help
      Time after all keys are released before suspending the half. This keeps
      the thumb wake GPIO inactive while entering System OFF.

config TOUCAN_SOFT_POWER_INIT_PRIORITY
    int
    default 41
    help
      POST_KERNEL initialization priority immediately after Zephyr's system
      work queue (40), so wake validation completes before the display,
      trackpad, radios, and ZMK services start.

endif

DT_COMPAT_TOUCAN_BATTERY_ESTIMATOR := zmk,toucan-battery-estimator
DT_COMPAT_TOUCAN_BATTERY_READOUT := zmk,behavior-toucan-battery-readout
DT_COMPAT_TOUCAN_PLATFORM_TOGGLE := zmk,behavior-toucan-platform-toggle
DT_COMPAT_TOUCAN_SPLIT_XY_PACKER := zmk,input-processor-toucan-split-xy-packer

config TOUCAN_PLATFORM_MODE
    bool "Toucan persistent macOS/Windows shortcut mode"
    default $(dt_compat_enabled,$(DT_COMPAT_TOUCAN_PLATFORM_TOGGLE))
    depends on SETTINGS
    help
      Provide the &cmd_key and &platform_mode behaviors. Command bindings send
      GUI in macOS mode and Control in Windows mode, while dedicated Control
      bindings remain unchanged. The selected mode persists across resets.

config TOUCAN_SPLIT_XY_PACKING
    bool "Pack Toucan split trackpad X/Y reports"
    default $(dt_compat_enabled,$(DT_COMPAT_TOUCAN_SPLIT_XY_PACKER))
    depends on ZMK_INPUT_SPLIT
    help
      Pack each adjacent relative X/Y pair into one peripheral-to-central
      input event, then reconstruct the pair on the central. ZMK v0.3 sends
      each input event in its own BLE notification; packing prevents normal
      trackpad motion from exhausting the peripheral's small TX buffer pool.

config TOUCAN_BATTERY_ESTIMATOR
    bool "Toucan filtered LiPo battery estimator"
    default $(dt_compat_enabled,$(DT_COMPAT_TOUCAN_BATTERY_ESTIMATOR))
    depends on SETTINGS
    select SENSOR
    help
      Wrap the XIAO's stock voltage-divider sensor with burst sampling, a
      nonlinear LiPo discharge curve, temporal filtering, and a small amount
      of persisted state so resets do not cause large percentage jumps.

if TOUCAN_BATTERY_ESTIMATOR

config TOUCAN_BATTERY_VOLTAGE_OFFSET_MV
    int "Per-half battery voltage calibration offset in millivolts"
    range -250 250
    default 0
    help
      Added to the voltage reported by the XIAO divider before estimating the
      charge percentage. Set this separately in toucan_left.conf and
      toucan_right.conf after comparing the reported voltage with a multimeter.

config TOUCAN_BATTERY_ESTIMATOR_INIT_PRIORITY
    int
    default 91
    help
      Initialize immediately after ZMK's stock voltage-divider sensor.

config TOUCAN_BATTERY_READOUT
    bool "Toucan on-demand raw battery voltage readout"
    default $(dt_compat_enabled,$(DT_COMPAT_TOUCAN_BATTERY_READOUT))
    depends on ZMK_SPLIT && ZMK_INPUT_SPLIT
    help
      Provide the global &battery behavior. Pressing it publishes each half's
      latest raw median ADC reading, relays the right reading to the central,
      and types both voltages through the selected HID endpoint.

endif
```

## dts/bindings/behaviors/zmk,behavior-toucan-app-switch-key.yaml
```yaml
# Copyright (c) 2026 Zerui Chen
# SPDX-License-Identifier: MIT

description: Send a key with Command on macOS or Alt in Windows mode

compatible: "zmk,behavior-toucan-app-switch-key"

include: one_param.yaml
```

## dts/bindings/behaviors/zmk,behavior-toucan-app-switch-layer.yaml
```yaml
# Copyright (c) 2026 Zerui Chen
# SPDX-License-Identifier: MIT

description: Hold an app-switch modifier while a momentary layer is active

compatible: "zmk,behavior-toucan-app-switch-layer"

include: one_param.yaml
```

## dts/bindings/behaviors/zmk,behavior-toucan-battery-readout.yaml
```yaml
# Copyright (c) 2026 Zerui Chen
# SPDX-License-Identifier: MIT

description: Type fresh raw battery voltage readings for both Toucan halves

compatible: "zmk,behavior-toucan-battery-readout"

include: zero_param.yaml
```

## dts/bindings/behaviors/zmk,behavior-toucan-bootloader.yaml
```yaml
description: Enter the local Toucan half's UF2 bootloader after display feedback

compatible: "zmk,behavior-toucan-bootloader"

include: zero_param.yaml
```

## dts/bindings/behaviors/zmk,behavior-toucan-command-key.yaml
```yaml
# Copyright (c) 2026 Zerui Chen
# SPDX-License-Identifier: MIT

description: Send a key with Command on macOS or Control in Windows mode

compatible: "zmk,behavior-toucan-command-key"

include: one_param.yaml
```

## dts/bindings/behaviors/zmk,behavior-toucan-memory-mode.yaml
```yaml
description: Toucan memory clear modifier

compatible: "zmk,behavior-toucan-memory-mode"

include: zero_param.yaml
```

## dts/bindings/behaviors/zmk,behavior-toucan-memory-set.yaml
```yaml
description: Begin recording a Toucan memory slot

compatible: "zmk,behavior-toucan-memory-set"

include: one_param.yaml
```

## dts/bindings/behaviors/zmk,behavior-toucan-memory-use.yaml
```yaml
description: Play or clear a Toucan memory slot

compatible: "zmk,behavior-toucan-memory-use"

include: one_param.yaml
```

## dts/bindings/behaviors/zmk,behavior-toucan-platform-toggle.yaml
```yaml
# Copyright (c) 2026 Zerui Chen
# SPDX-License-Identifier: MIT

description: Toggle the persistent Toucan macOS or Windows shortcut mode

compatible: "zmk,behavior-toucan-platform-toggle"

include: zero_param.yaml
```

## dts/bindings/input_processors/zmk,input-processor-toucan-split-xy-packer.yaml
```yaml
# Copyright (c) 2026 Zerui Chen
# SPDX-License-Identifier: MIT

description: Pack adjacent relative X/Y events for the Toucan split transport

compatible: "zmk,input-processor-toucan-split-xy-packer"

include: ip_zero_param.yaml
```

## dts/bindings/sensor/zmk,toucan-battery-estimator.yaml
```yaml
# Copyright (c) 2026 Zerui Chen
# SPDX-License-Identifier: MIT

description: Filtered state-of-charge estimator wrapping another battery sensor

compatible: "zmk,toucan-battery-estimator"

include: sensor-device.yaml

properties:
  source:
    type: phandle
    required: true
    description: Battery sensor providing SENSOR_CHAN_GAUGE_VOLTAGE
```
