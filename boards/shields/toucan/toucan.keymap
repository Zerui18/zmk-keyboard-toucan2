/*
 * Keep the shield fallback build on the same keymap as the local/GitHub
 * configuration. Normal project builds select config/toucan.keymap directly;
 * this include prevents an accidental no-ZMK_CONFIG build from drifting.
 */

#include "../../../config/toucan.keymap"
